## Kconfig
```kconfig
menu "Google IoT Core Configuration"

config GIOT_PROJECT_ID
    string "Google Cloud Project ID"
    default "test-technique-315904"
    help
        Google Cloud project ID

config GIOT_LOCATION
    string "Google Cloud location"
    default "asia-east1"
    help
        Google Cloud region

config GIOT_REGISTRY_ID
    string "Google IoT Core Registry ID"
    default "fridge-open-notif"
    help
        Google IoT Core registry id

config GIOT_DEVICE_ID
    string "Google IoT Core Device ID"
    default "esp32"
    help
        Google IoT Core device id

config GIOT_DEBUG_OUTPUT
    bool "Enable debugging"
    help
        Select this option to enable debugging support

config CONFIG_ESP_TLS_PSK_VERIFICATION
    bool "Enable TLS PSK Verification"
    help
        Select this option to enable TLS verificaiton
endmenu
```

## main/Kconfig.projbuild
```kconfig
menu "Example Configuration"

config ESP_WIFI_SSID
    string "WiFi SSID"
    default "House of Jank 2.4"
    help
	SSID (network name) for the example to connect to.

config ESP_WIFI_PASSWORD
    string "WiFi Password"
    default "123321GreenFridge"
    help
	WiFi password (WPA or WPA2) for the example to use.

endmenu
```
